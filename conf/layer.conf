## conf/layer.conf
```bitbake
# We have a conf and classes directory, add to BBPATH
BBPATH .= ":${LAYERDIR}"

# We have a recipes directory containing .bb and .bbappend files, add to BBFILES
BBFILES += "${LAYERDIR}/recipes-*/*/*.bb \
			${LAYERDIR}/recipes-*/*/*.bbappend"

BBFILE_COLLECTIONS += "telechips-topst-bsp"
BBFILE_PATTERN_telechips-topst-bsp = "^${LAYERDIR}/"
BBFILE_PRIORITY_telechips-topst-bsp = "8"

# This should only be incremented on significant changes that will
# cause compatibility issues with other layers
LAYERVERSION_telechips-topst-bsp = "2"
LAYERDEPENDS_telechips-topst-bsp = "core"
LAYERSERIES_COMPAT_telechips-topst-bsp = "kirkstone"

LICENSE_PATH += "${LAYERDIR}/licenses"

COMPATIBLE_LICENSES:append = " ARM"
IMAGE_FEATURES[validitems] += "uboot-fit"

SDK_VENDOR = "-topst"

# Set Telechips git
TELECHIPS_TOPST_GIT ??= "git://github.com/topst-development"

TOPST_GIT_PROTOCOL ??= "https"
TOPST_BRANCH ??= "develop"

# Add preferred versions
PREFERRED_VERSION_mesa ?= "22.%"
PREFERRED_VERSION_wayland ?= "1.20.0"
PREFERRED_VERSION_wayland-native ?= "1.20.0"
PREFERRED_VERSION_nativesdk-wayland ?= "1.20.0"
PREFERRED_VERSION_weston ?= "10.%"

PREFERRED_PROVIDER_virtual/kernel ?= "linux-topst"
PREFERRED_VERSION_linux-topst = "${LINUX_VERSION}"
PREFERRED_VERSION_linux-libc-headers = "${LINUXLIBCVERSION}"

PREFERRED_PROVIDER_virtual/libomxil ?= "libomxil-telechips"
VIRTUAL-RUNTIME_libomxil ?= "libomxil-telechips"

PREFERRED_PROVIDER_virtual/crypt ?= "glibc"
PREFERRED_PROVIDER_virtual/nativesdk-crypt ?= "nativesdk-glibc"

# Set gcc version
GCCVERSION ?= "arm-11.2"

DEFAULT_USER_NAME ?= "topst"
DEFAULT_GROUP_NAME ?= "topst"
DEFAULT_PASSWORD ?= "topst"
DEFAULT_ROOT_PASSWORD ?= "root"

# Exclude recipes from being cleared by rm_work
RM_WORK_EXCLUDE += " \
		u-boot-topst initramfs-topst-image linux-topst kernel-devsrc boot-firmware hsm \
		tc-enable-removable-disk topst-vpu hsm \
		telechips-egl mesa powervr powervr-app t-media-framework \
		gstreamer1.0 gstreamer1.0-plugins-base gstreamer1.0-plugins-good gstreamer1.0-plugins-bad \
"
OPENGL_SAMPLE_APP:tcc805x = "${@bb.utils.contains('TCC_BSP_FEATURES', 'drm', 'powervr-app kmscube', 'powervr-app gles-samples', d)}"
OPENGL_SAMPLE_APP:tcc807x = "${@bb.utils.contains('TCC_BSP_FEATURES', 'drm', 'kmscube', 'tc-teapot-light', d)}"
OPENGL_SAMPLE_APP:tcc750x = ""
```

## conf/machine/ai-g-topst.conf
```bitbake
#@TYPE: Machine
#@NAME: tcc7500 machine
#@DESCRIPTION: Machine configuration for the Telechips Evaluation Board

# don't reverse the order of 'DEFAULTTUNE' and 'require conf/machine/include/tune-cortexa53.inc'

require conf/machine/include/arm/armv8a/tune-cortexa53.inc
require conf/machine/include/tune-cortexa53-arm.inc
require conf/machine/topst.inc

SOC_FAMILY = "tcc750x:ai-g-topst"

UBOOT_DEVICE_TREE ??= "telechips/tcc750x/tcc7500-lpd4x321"
KERNEL_DEVICETREE ??= "telechips/tcc750x/tcc7500-lpd4x321.dtb"

BOOT_STORAGE ??= "emmc"
SERIAL_CONSOLES = "115200;ttyAMA2"
KERNEL_CONSOLE = "ttyAMA2"

CONFLICT_MACHINE_FEATURES = "ufs"

EXTRA_IMAGEDEPENDS += "u-boot-topst"

UBOOT_NAME ??= "u-boot"
UBOOT_SUFFIX = "rom"
UBOOT_MACHINE ??= "tcc750x_defconfig"

# UBOOT_MAKE_TARGET = "tcc750x"
UBOOT_IMAGE = "${UBOOT_NAME}-${MACHINE}-${PV}-${PR}.${UBOOT_SUFFIX}"
UBOOT_BINARY = "${UBOOT_NAME}.${UBOOT_SUFFIX}"
UBOOT_SYMLINK = "${UBOOT_NAME}-${MACHINE}.${UBOOT_SUFFIX}"

KBUILD_DEFCONFIG ??= "tcc750x_defconfig"
KERNEL_BASE_ADDR = "0x20000000"

UPDATE_BOOTLOADER_NAME = "${UBOOT_NAME}.${UBOOT_SUFFIX}"
UPDATE_KERNEL_NAME = "tc-boot-${MACHINE}.img"
UPDATE_ROOTFS_NAME = "${IMAGE_LINK_NAME}.${DEFAULT_IMAGE_FSTYPE}"
#UPDATE_SNOR_NAME = "tcc750x_snor.rom"
UPDATE_DTB_NAME = "${@d.getVar("KERNEL_DEVICETREE").split("/")[-1]}"

#PREFERRED_PROVIDER_virtual/kernel = "linux-telechips"

# Telechips EVB UFS Size
TCC_UFS_STORAGE_SIZE ?= "63988301824"
# Telechips TOPST-AI EVB eMMc Size
TCC_EMMC_STORAGE_SIZE ?= "7818182656"
SYSTEM_PARTITION_SIZE = "5120"

# data partition size
MAX_DATA_SIZE = "1"
HOME_DATA_SIZE = "800"

# Prevent Build error
SUBCORE_DEPLOY_DIR ?= ""
SUBCORE_BOOT_IMAGE_NAME ?= ""
SUBCORE_DTB_IMAGE_NAME ?= ""
SUBCORE_ROOTFS_IMAGE_NAME ?= ""

EXTRA_CMDLINE += "console=ttyAMA2,115200n8"

LINUX_VERSION ??= "5.10.223"

TELECHIPS_AUTOMOTIVE_GIT ??= "git://rgit.telechips.com/linux/linux_yp4.0_nn/1.0.0"
TELECHIPS_AUTOMOTIVE_BSP_GIT ??= "git://rgit.telechips.com/linux/linux_yp4.0_nn/1.0.0/bsp"
TELECHIPS_AUTOMOTIVE_MULTIMEDIA_GIT ??= "git://rgit.telechips.com/linux/linux_yp4.0_nn/1.0.0/multimedia"

TCC_BSP_FEATURES ??= ""
TCC_BSP_FEATURES:append = "${@bb.utils.contains('TOPST_FEATURES', 'display', ' display', '', d)}"
TCC_BSP_FEATURES:append = "${@bb.utils.contains('TOPST_FEATURES', 'camera', ' camera', '', d)}"
```

## conf/machine/d3-g-topst-main.conf
```bitbake
#@TYPE: Machine
#@NAME: Telechips TOPST D3 Main Core
#@DESCRIPTION: Machine configuration for the Telechips TOPST D3 Board

require conf/machine/include/arm/armv8a/tune-cortexa72.inc
require conf/machine/topst.inc

SOC_FAMILY = "tcc805x:d3-g-topst-main"

UBOOT_DEVICE_TREE ??= "telechips/tcc805x/tcc8050-topst-d3-g"
KERNEL_DEVICETREE ??= "telechips/tcc805x/tcc8050-topst-d3-g.dtb"

GST_ARCH_FAMILY_NAME = "TCC_805x"
LCD_WIDTH ??= "1920"
LCD_HEIGHT ??= "720"

BOOT_STORAGE ??= "emmc"
SERIAL_CONSOLES = "115200;ttyAMA0"
KERNEL_CONSOLE = "ttyAMA0"

EXTRA_IMAGEDEPENDS += "u-boot-topst"

UBOOT_NAME ??= "ca72_bl3"
UBOOT_SUFFIX = "rom"
UBOOT_MACHINE ??= "d3_g_topst_defconfig"

KBUILD_DEFCONFIG ??= "d3_g_topst_defconfig"
KERNEL_BASE_ADDR = "0x20000000"

UPDATE_BOOTLOADER_NAME = "${UBOOT_NAME}.${UBOOT_SUFFIX}"
UPDATE_KERNEL_NAME = "tc-boot-${MACHINE}.img"
UPDATE_ROOTFS_NAME = "${IMAGE_LINK_NAME}.${DEFAULT_IMAGE_FSTYPE}"
UPDATE_SNOR_NAME = "tcc8050_snor.cs.rom"
UPDATE_DTB_NAME = "${@d.getVar("KERNEL_DEVICETREE").split("/")[-1]}"

# GPU configuration
PREFERRED_PROVIDER_virtual/egl			= "${@bb.utils.contains('DISTRO_FEATURES', 'wayland', 'mesa', 'powervr', d)}"
PREFERRED_PROVIDER_virtual/libgles1		= "${@bb.utils.contains('DISTRO_FEATURES', 'wayland', 'mesa', 'powervr', d)}"
PREFERRED_PROVIDER_virtual/libgles2		= "${@bb.utils.contains('DISTRO_FEATURES', 'wayland', 'mesa', 'powervr', d)}"
PREFERRED_PROVIDER_virtual/mesa			= "${@bb.utils.contains('DISTRO_FEATURES', 'wayland', 'mesa', 'powervr', d)}"
PREFERRED_PROVIDER_libglapi				= "${@bb.utils.contains('DISTRO_FEATURES', 'wayland', 'mesa', '', d)}"
PREFERRED_PROVIDER_libgbm				= "${@bb.utils.contains('DISTRO_FEATURES', 'wayland', 'mesa', '', d)}"
PREFERRED_PROVIDER_libwayland-egl		= "${@bb.utils.contains('DISTRO_FEATURES', 'wayland', 'mesa', '', d)}"
PREFERRED_PROVIDER_vulkan-loader		= "powervr"

GPU_DRIVER_MODE ??= "${@bb.utils.contains_any("TCC_BSP_FEATURES", 'gpu-vz', 'guest', 'native', d)}"

# Telechips EVB UFS Size
TCC_UFS_STORAGE_SIZE ?= "31998345216"
# Telechips EVB eMMc Size
TCC_EMMC_STORAGE_SIZE ?= "31268536320"
```

## conf/machine/d5-g-topst-main.conf
```bitbake
#@TYPE: Machine
#@NAME: Telechips TOPST D5 Main Core
#@DESCRIPTION: Machine configuration for the Telechips TOPST D5 Board

require conf/machine/include/arm/armv8-2a/tune-cortexa76-cortexa55.inc
require conf/machine/topst.inc

SOC_FAMILY = "tcc807x:d5-g-topst-main"

UBOOT_DEVICE_TREE ??= "telechips/tcc807x/tcc8070-topst-d5-g"
KERNEL_DEVICETREE ??= "telechips/tcc807x/tcc8070-topst-d5-g.dtb"

GST_ARCH_FAMILY_NAME = "TCC_807x"
LCD_WIDTH ??= "1920"
LCD_HEIGHT ??= "720"

BOOT_STORAGE ??= "emmc"
SERIAL_CONSOLES = "115200;ttyAMA0"
KERNEL_CONSOLE = "ttyAMA0"

EXTRA_IMAGEDEPENDS += "u-boot-topst"

UBOOT_NAME ??= "ap0_bl3"
UBOOT_SUFFIX = "rom"
UBOOT_MACHINE ??= "d5_g_topst_defconfig"

KBUILD_DEFCONFIG ??= "d5_g_topst_defconfig"
KERNEL_BASE_ADDR = "0x20000000"

UPDATE_BOOTLOADER_NAME = "${UBOOT_NAME}.${UBOOT_SUFFIX}"
UPDATE_KERNEL_NAME = "tc-boot-${MACHINE}.img"
UPDATE_ROOTFS_NAME = "${IMAGE_LINK_NAME}.${DEFAULT_IMAGE_FSTYPE}"
UPDATE_DTB_NAME = "${@d.getVar("KERNEL_DEVICETREE").split("/")[-1]}"

# GPU configuration
PREFERRED_PROVIDER_virtual/egl			= "telechips-egl"
PREFERRED_PROVIDER_virtual/libgles1		= "telechips-egl"
PREFERRED_PROVIDER_virtual/libgles2		= "telechips-egl"
PREFERRED_PROVIDER_virtual/libgles3		= "telechips-egl"
PREFERRED_PROVIDER_virtual/libgbm		= "telechips-egl"
PREFERRED_PROVIDER_virtual/mesa			= "telechips-egl"
PREFERRED_PROVIDER_libglapi			= "telechips-egl"
PREFERRED_PROVIDER_libwayland-egl		= "telechips-egl"

# Telechips EVB UFS Size
TCC_UFS_STORAGE_SIZE ?= "63988301824"
# Telechips EVB eMMc Size
TCC_EMMC_STORAGE_SIZE ?= "31268536320"
```

## conf/machine/topst.inc
```bitbake
#@TYPE: Machine
#@NAME: Telechips TOPST SOC Family
#@DESCRIPTION: Machine configuration for the Telechips TOPST Board

# Ship all kernel modules by default
MACHINE_EXTRA_RRECOMMENDS = "kernel-modules"

DEFAULT_IMAGE_FSTYPE ?= "ext4"
SWITCH_ROOTFS_MOUNT_OPT ?= "-o ro,noatime,noload"
MKUBIFS_ARGS = "--min-io-size 4096 --leb-size 516096 --max-leb-cnt 8139"

TCC_ARCH_FAMILY ?= "${@d.getVar("SOC_FAMILY").split(":")[0]}"
TCC_MACHINE_FAMILY ?= "${TCC_ARCH_FAMILY}-${@d.getVar("SOC_FAMILY").split("-")[-1]}"

MACHINE_FEATURES = "usbgadget usbhost vfat alsa"
MACHINE_FEATURES += "${@oe.utils.conditional('BOOT_STORAGE', 'ufs', 'ufs', 'emmc', d)}"

# initramfs -> pivot root
# default rootfs is initramfs
# If you do not want to use the initramfs,
# you have to set 'INITRAMFS_IMAGE' and 'INITRAMFS_TASK' to NULL("") on your conf/local.conf

INITRAMFS_FSTYPES ?= "cpio"
INITRAMFS_IMAGE ?= "initramfs-topst-image"
INITRAMFS_IMAGE_BUNDLE = "1"

KERNEL_IMAGETYPES ?= "${@bb.utils.contains('IMAGE_FEATURES', 'uboot-fit', 'fitImage', '', d)}"
KERNEL_CLASSES ?= "${@bb.utils.contains('IMAGE_FEATURES', 'uboot-fit', 'kernel-fitimage', '', d)}"
UBOOT_ENTRYPOINT ?= "0x20080000"
UBOOT_DTB_LOADADDRESS ?= "0x23000000"

EXTRA_CMDLINE += "${@bb.utils.contains('DISTRO_FEATURES', 'systemd', 'fsck.repair=yes', '', d)}"
CMDLINE ?= "'quiet ${EXTRA_CMDLINE}'"

KCONFIG_MODE ?= "--alldefconfig"

KERNEL_MACH_PATH ?= "arch/arm/mach-${TCC_ARCH_FAMILY}"
TARGET_ARCH_ALIAS ?= "${TARGET_ARCH}"
TARGET_ARCH_ALIAS:aarch64 ?= "arm64"

require conf/machine/include/soc-family.inc

LINUX_VERSION ??= "5.10.205"
LINUXLIBCVERSION ?= "5.10"
LINUX_VERSION_EXTENSION = "-tcc"

TCC_BSP_FEATURES:tcc805x ??= "audio display graphics camera"
TCC_BSP_FEATURES:tcc807x ??= "audio display graphics camera"
TCC_BSP_FEATURES:tcc750x ??= ""
TOPST_FEATURES ??= ""
TCC_BSP_FEATURES:append = "${@bb.utils.contains('DISTRO_FEATURES', 'wayland', ' drm', '', d)}"
TCC_BSP_FEATURES:append = "${@bb.utils.contains('TOPST_FEATURES', 'optee', ' optee', '', d)}"
TCC_BSP_FEATURES:append = "${@bb.utils.contains('TOPST_FEATURES', 'with-subcore', ' with-subcore camera', '', d)}"
TCC_BSP_FEATURES:append = "${@bb.utils.contains('TOPST_FEATURES', 'gpu-vz', ' gpu-vz', '', d)}"
TCC_BSP_FEATURES:append = "${@bb.utils.contains('TOPST_FEATURES', 'network', ' network', '', d)}"
TCC_BSP_FEATURES:append:tcc805x = "${@bb.utils.contains('TOPST_FEATURES', 'multimedia', ' multimedia_vpu_v3', '', d)}"
TCC_BSP_FEATURES:append:tcc807x = "${@bb.utils.contains('TOPST_FEATURES', 'multimedia', ' multimedia_vpu_v3', '', d)}"

TCC_BSP_FEATURES:append:tcc750x = "${@bb.utils.contains('TOPST_FEATURES', 'display', ' display', '', d)}"
TCC_BSP_FEATURES:append:tcc750x = "${@bb.utils.contains('TOPST_FEATURES', 'camera', ' camera', '', d)}"
TCC_BSP_FEATURES:append:tcc750x = "${@bb.utils.contains('TOPST_FEATURES', 'multimedia', ' multimedia_vpu_v3', '', d)}"

FWDN_VERSION = "8"
DATA_PART_FSTYPE = "ext4"

STORAGE_SIZE ?= "${@oe.utils.conditional('BOOT_STORAGE', 'ufs', '${TCC_UFS_STORAGE_SIZE}', '${TCC_EMMC_STORAGE_SIZE}', d)}"
# Set system partition size. MB
SYSTEM_PARTITION_SIZE ?= "20480"
# Set maximum size of user rw parition. MB
MAX_DATA_SIZE ?= "1024"
# Set size of home rw parition. MB
HOME_DATA_SIZE ?= "500"

SPLASH_IMAGE ?= "${@oe.utils.conditional('BOOT_STORAGE', 'ufs', 'splash_1920x720x32_ufs.img', 'splash_1920x720x32.img', d)}"
SPLASH_IMAGE:tcc803x = "splash_1920x720x32_tcc803x.img"
```
